## kernel/Kconfig
```kconfig
menu "KernelSU"

config KSU
	tristate "KernelSU function support"
	default y
	help
	  Enable kernel-level root privileges on Android System.
	  Requires CONFIG_KPROBES for kernel hooking support.
	  To compile as a module, choose M here: the
	  module will be called kernelsu.

config KSU_DEBUG
	bool "KernelSU debug mode"
	depends on KSU
	default n
	help
	  Enable KernelSU debug mode.

config KSU_DISABLE_MANAGER
	bool "Disable KernelSU manager integration"
	depends on KSU
	default n
	help
	  Disable manager APK detection and manager-specific handling.
	  Root will be used in place of manager-only functionality.

config KSU_DISABLE_POLICY
	bool "Disable KernelSU policy profiles"
	depends on KSU
	default n
	help
	  Disable per-app root/non-root profile customization.
	  Escalation will always use the default full root profile, and
	  non-root handling will follow the global umount policy only.

config KSU_ALLOWLIST_WORKAROUND
	bool "KernelSU allowlist workaround"
	depends on KSU
	default n
	help
	  Enable workaround for broken allowlist save

# For easier extern ifdef handling
config KSU_MANUAL_HOOK
	bool "KernelSU manual hook mode."
	depends on KSU && KSU != m
	default y if !KPROBES
	default n
	help
	  Enable manual hook support.

config KSU_KPROBES_HOOK
	bool "KernelSU tracepoint+kretprobe hook"
	depends on KSU && !KSU_MANUAL_HOOK
	depends on KRETPROBES && KPROBES && HAVE_SYSCALL_TRACEPOINTS
	default y if KPROBES && KRETPROBES && HAVE_SYSCALL_TRACEPOINTS
	default y if !KSU_MANUAL_HOOK
	help
	  Enable KPROBES, KRETPROBES and TRACEPOINT hook for KernelSU core.
	  This should not be used on kernel below 5.10.

menu "KernelSU - SUSFS"
config KSU_SUSFS
    bool "KernelSU addon - SUSFS"
    depends on KSU
    default y
    help
      Patch and Enable SUSFS to kernel with KernelSU

config KSU_SUSFS_SUS_PATH
    bool "Enable to hide suspicious path"
    depends on KSU_SUSFS
    default y
    help
      Allow hiding the existence of user-defined file/directory from various system calls

config KSU_SUSFS_SUS_MOUNT
    bool "Enable to hide suspicious mounts"
    depends on KSU_SUSFS
    default y
    help
      Allow hiding the user-defined mount paths from /proc/self/[mounts|mountinfo|mountstat]

config KSU_SUSFS_SUS_KSTAT
    bool "Enable to spoof suspicious kstat"
    depends on KSU_SUSFS
    default y
    help
      Allow spoofing the kstat of user-defined file/directory

config KSU_SUSFS_SUS_OVERLAYFS
    bool "Enable to automatically spoof kstat and kstatfs for overlayed files/directories"
    depends on KSU_SUSFS
    default y
    help
      Automatically spoof the kstat and kstatfs for overlayed files/directories.
      No susfs command is needed in userspace.
      Effective on all processes.

config KSU_SUSFS_TRY_UMOUNT
    bool "Enable to use ksu's try_umount"
    depends on KSU_SUSFS
    default y
    help
      Allow using ksu's umount to umount other user-defined mount paths prior to ksu's default umount paths.
      Effective on all NO-root-access-granted processes.

config KSU_SUSFS_SPOOF_UNAME
    bool "Enable to spoof uname"
    depends on KSU_SUSFS
    default y
    help
      Allow spoofing the string returned by uname syscall to user-defined string.
      Effective on all processes.

config KSU_SUSFS_ENABLE_LOG
    bool "Enable logging susfs log to kernel"
    depends on KSU_SUSFS
    default y
    help
      Allow logging susfs log to kernel, uncheck it to completely disable all susfs log.

config KSU_SUSFS_SUS_SU
    bool "Enable SUS-SU in runtime temporarily (experimental)"
    depends on KSU_SUSFS
    default y
    help
      Allow user to enable or disable core ksu kprobes hooks temporarily in runtime.
      When enabling sus_su, kprobes of ksu will be disabled, and a fifo driver will be created in /dev/[random_string].
      (for first time only), then user needs to mount the 'sus_su' to /system/bin/su using overlayfs or whatever techniques,
      and run 'su' to get root shell from the fifo driver. Or, refer to the method in service.sh from module template.
      When disabling sus_su, kprobes of ksu will be enabled again, and the fifo driver will be deleted.
      Only apps with root access granted by ksu manager are allowed to get root.
      Also overlayfs is required.
config KSU_SUSFS_SPOOF_CMDLINE_OR_BOOTCONFIG
    bool "Enable to spoof cmdline or bootconfig"
    depends on KSU_SUSFS
    default y
    help
      Allow spoofing the cmdline or bootconfig.

config KSU_SUSFS_OPEN_REDIRECT
    bool "Enable to redirect open() to a user-defined path"
    depends on KSU_SUSFS
    default y
    help
      Allow redirecting the open() of a sus_path to a fake path.

config KSU_SUSFS_SUS_MAP
    bool "Enable to hide suspicious memory mappings"
    depends on KSU_SUSFS
    default y
    help
      Allow hiding suspicious memory mappings from /proc/self/maps.

config KSU_SUSFS_HIDE_KSU_SUSFS_SYMBOLS
    bool "Enable to hide ksu and susfs symbols from kallsyms"
    depends on KSU_SUSFS
    default y
    help
      Allow hiding ksu/susfs symbols from /proc/kallsyms.

endmenu

endmenu
```
